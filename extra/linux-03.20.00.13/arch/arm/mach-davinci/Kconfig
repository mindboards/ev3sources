## extra/linux-03.20.00.13/arch/arm/mach-davinci/Kconfig
```kconfig
if ARCH_DAVINCI

config AINTC
	bool

config CP_INTC
	bool

config ARCH_DAVINCI_DMx
	bool

menu "TI DaVinci Implementations"

comment "DaVinci Core Type"

config ARCH_DAVINCI_DM644x
	bool "DaVinci 644x based system"
	select AINTC
	select ARCH_DAVINCI_DMx

config ARCH_DAVINCI_DM355
        bool "DaVinci 355 based system"
	select AINTC
	select ARCH_DAVINCI_DMx

config ARCH_DAVINCI_DM646x
        bool "DaVinci 646x based system"
	select AINTC
	select ARCH_DAVINCI_DMx

config ARCH_DAVINCI_DA830
        bool "DA830/OMAP-L137/AM17xx based system"
	select CP_INTC
	select ARCH_DAVINCI_DA8XX

config ARCH_DAVINCI_DA850
	bool "DA850/OMAP-L138/AM18xx based system"
	select CP_INTC
	select ARCH_DAVINCI_DA8XX
	select ARCH_HAS_CPUFREQ

choice
	prompt "Select Maximum DA850/OMAP-L138/AM18xx SoC speed"
	depends on ARCH_DAVINCI_DA850
	help
	  Select the maximum speed the SoC can operate at.

config DA8XX_MAX_SPEED_300
	bool "300 MHz"

config DA8XX_MAX_SPEED_372
	bool "372 MHz"

config DA8XX_MAX_SPEED_408
	bool "408 MHz"

config DA8XX_MAX_SPEED_456
	bool "456 MHz"
endchoice

config ARCH_DAVINCI_DA8XX
	bool

config ARCH_DAVINCI_DM365
	bool "DaVinci 365 based system"
	select AINTC
	select ARCH_DAVINCI_DMx

comment "DaVinci Board Type"

config MACH_DAVINCI_EVM
	bool "TI DM644x EVM"
	default ARCH_DAVINCI_DM644x
	depends on ARCH_DAVINCI_DM644x
	help
	  Configure this option to specify the whether the board used
	  for development is a DM644x EVM

config MACH_SFFSDR
	bool "Lyrtech SFFSDR"
	depends on ARCH_DAVINCI_DM644x
	help
	  Say Y here to select the Lyrtech Small Form Factor
	  Software Defined Radio (SFFSDR) board.

config MACH_NEUROS_OSD2
	bool "Neuros OSD2 Open Television Set Top Box"
	depends on ARCH_DAVINCI_DM644x
	help
	  Configure this option to specify the whether the board used
	  for development is a Neuros OSD2 Open Set Top Box.

config MACH_DAVINCI_DM355_EVM
	bool "TI DM355 EVM"
	default ARCH_DAVINCI_DM355
	depends on ARCH_DAVINCI_DM355
	help
	  Configure this option to specify the whether the board used
	  for development is a DM355 EVM

config MACH_DM355_LEOPARD
	bool "DM355 Leopard board"
	depends on ARCH_DAVINCI_DM355
	help
	  Configure this option to specify the whether the board used
	  for development is a DM355 Leopard board.

config MACH_DAVINCI_DM6467_EVM
	bool "TI DM6467 EVM"
	default ARCH_DAVINCI_DM646x
	depends on ARCH_DAVINCI_DM646x
	select MACH_DAVINCI_DM6467TEVM
	help
	  Configure this option to specify the whether the board used
	  for development is a DM6467 EVM

config MACH_DAVINCI_DM6467TEVM
	bool

config MACH_DAVINCI_DM365_EVM
	bool "TI DM365 EVM"
	default ARCH_DAVINCI_DM365
	depends on ARCH_DAVINCI_DM365
	help
	  Configure this option to specify whether the board used
	  for development is a DM365 EVM

config MACH_DAVINCI_DA830_EVM
	bool "TI DA830/OMAP-L137/AM17xx Reference Platform"
	default ARCH_DAVINCI_DA830
	depends on ARCH_DAVINCI_DA830
	select GPIO_PCF857X
	help
	  Say Y here to select the TI DA830/OMAP-L137/AM17xx Evaluation Module.

choice
	prompt "Select DA830/OMAP-L137/AM17xx UI board peripheral"
	depends on MACH_DAVINCI_DA830_EVM
	help
	  The presence of UI card on the DA830/OMAP-L137/AM17xx EVM is
	  detected automatically based on successful probe of the I2C
	  based GPIO expander on that board. This option selected in this
	  menu has an effect only in case of a successful UI card detection.

config DA830_UI_LCD
	bool "LCD"
	help
	  Say Y here to use the LCD as a framebuffer or simple character
	  display.

config DA830_UI_NAND
	bool "NAND flash"
	help
	  Say Y here to use the NAND flash.  Do not forget to setup
	  the switch correctly.
endchoice

config MACH_DAVINCI_DA850_EVM
	bool "TI DA850/OMAP-L138/AM18xx Reference Platform"
	default ARCH_DAVINCI_DA850
	depends on ARCH_DAVINCI_DA850
	select GPIO_PCA953X
	help
	  Say Y here to select the TI DA850/OMAP-L138/AM18xx Evaluation Module.

choice
	prompt "Select peripherals connected to expander on UI board"
	depends on MACH_DAVINCI_DA850_EVM
	help
	  The presence of User Interface (UI) card on the DA850/OMAP-L138/AM18xx
	  EVM is detected automatically based on successful probe of the I2C
	  based GPIO expander on that card. This option selected in this
	  menu has an effect only in case of a successful UI card detection.

config DA850_UI_NONE
	bool "No peripheral is enabled"
	help
	  Say Y if you do not want to enable any of the peripherals connected
	  to TCA6416 expander on DA850/OMAP-L138/AM18xx EVM UI card

config DA850_UI_RMII
	bool "RMII Ethernet PHY"
	help
	  Say Y if you want to use the RMII PHY on the DA850/OMAP-L138/AM18xx
	  EVM. This PHY is found on the UI daughter card that is supplied with
	  the EVM. NOTE: Please take care while choosing this option, MII PHY
	  will not be functional if RMII mode is selected.

config DA850_UI_CLCD
	bool "Character LCD"
	help
	  Say Y if you want to use Character LCD on the DA850/OMAP-L138/AM18xx
	  EVM. The Character LCD is found on the UI daughter card that is
	  supplied with the EVM.
	  NOTE: Please take care while choosing this option, Graphical LCD will
	  not be functional if Character LCD is selected.

config DA850_UI_VIDEO_PORT
	bool "Video Port Interface"
	help
	  Say Y if you want to use Video Port Interface (VPIF) on the
	  DA850/OMAP-L138 EVM. The Video decoders/encoders are found on the
	  UI daughter card that is supplied with the EVM.
	  NOTE: Please make sure to disable RMII and CLCD options when you
	  select Video Port Interface.
endchoice

config DAVINCI_MUX
	bool "DAVINCI multiplexing support"
	depends on ARCH_DAVINCI
	default y
	help
	  Pin multiplexing support for DAVINCI boards. If your bootloader
	  sets the multiplexing correctly, say N. Otherwise, or if unsure,
	  say Y.

config DAVINCI_MUX_DEBUG
        bool "Multiplexing debug output"
        depends on DAVINCI_MUX
        help
          Makes the multiplexing functions print out a lot of debug info.
          This is useful if you want to find out the correct values of the
          multiplexing registers.

config DAVINCI_MUX_WARNINGS
        bool "Warn about pins the bootloader didn't set up"
        depends on DAVINCI_MUX
        help
          Choose Y here to warn whenever driver initialization logic needs
          to change the pin multiplexing setup.  When there are no warnings
          printed, it's safe to deselect DAVINCI_MUX for your product.

config DAVINCI_RESET_CLOCKS
	bool "Reset unused clocks during boot"
	depends on ARCH_DAVINCI
	help
	  Say Y if you want to reset unused clocks during boot.
	  This option saves power, but assumes all drivers are
	  using the clock framework. Broken drivers that do not
	  yet use clock framework may not work with this option.
	  If you are booting from another operating system, you
	  probably do not want this option enabled until your
	  device drivers work properly.

config DAVINCI_MCBSP
	bool "DaVinci McBSP (serial API) support"
	depends on ARCH_DAVINCI
	default n
	help
	  Say Y if you want to use McBSP on DaVinci platforns as a
	  serial interface instead of using it as an audio interface.

config DAVINCI_MCBSP0
	bool "Support for McBSP instance 0"
	depends on DAVINCI_MCBSP
	default n

config DAVINCI_MCBSP1
	bool "Support for McBSP instance 1"
	depends on DAVINCI_MCBSP
	default n


config DAVINCI_C_FIQ 
       bool "FIQ ISR support in C" 
       depends on ARCH_DAVINCI 
       select FIQ 
       help 
         Support for Davinci FIQ support in C -- see 
         ./arch/arm/mach-davinci/davinci-fiq.c 

endmenu

endif
```

## extra/linux-03.20.00.13/drivers/net/can/omapl_pru/Kconfig
```kconfig
config CAN_TI_OMAPL_PRU
	depends on CAN_DEV && ARCH_DAVINCI && ARCH_DAVINCI_DA850
	tristate "PRU based CAN emulation for OMAPL"
	---help---
	Enable this to emulate a CAN controller on the PRU of OMAPL.
	If not sure, mark N

config OMAPL_CAN_FW_SOURCE
    string "OMAPL PRU CAN source file(s)"
    depends on CAN_TI_OMAPL_PRU
    default ""
    ---help---
    Enter the path for the OMAPL PRU CAN source files (<system path>/pru)

config OMAPL_PRU_CANID_MBX0
    hex "CANID for mailbox 0"
    depends on CAN_TI_OMAPL_PRU
    default "0x123"
    ---help---
    Enter the CANID for mailbox 0

config OMAPL_PRU_CANID_MBX1
    hex "CANID for mailbox 1"
    depends on CAN_TI_OMAPL_PRU
    default "0x123"
    ---help---
    Enter the CANID for mailbox 1

config OMAPL_PRU_CANID_MBX2
    hex "CANID for mailbox 2"
    depends on CAN_TI_OMAPL_PRU
    default "0x123"
    ---help---
    Enter the CANID for mailbox 2

config OMAPL_PRU_CANID_MBX3
    hex "CANID for mailbox 3"
    depends on CAN_TI_OMAPL_PRU
    default "0x123"
    ---help---
    Enter the CANID for mailbox 3

config OMAPL_PRU_CANID_MBX4
    hex "CANID for mailbox 4"
    depends on CAN_TI_OMAPL_PRU
    default "0x123"
    ---help---
    Enter the CANID for mailbox 4

config OMAPL_PRU_CANID_MBX5
    hex "CANID for mailbox 5"
    depends on CAN_TI_OMAPL_PRU
    default "0x123"
    ---help---
    Enter the CANID for mailbox 5

config OMAPL_PRU_CANID_MBX6
    hex "CANID for mailbox 6"
    depends on CAN_TI_OMAPL_PRU
    default "0x123"
    ---help---
    Enter the CANID for mailbox 6

config OMAPL_PRU_CANID_MBX7
    hex "CANID for mailbox 7"
    depends on CAN_TI_OMAPL_PRU
    default "0x123"
    ---help---
    Enter the CANID for mailbox 7
```

## extra/linux-03.20.00.13/drivers/serial/omapl_pru__/Kconfig
```kconfig
config SERIAL_SUART_OMAPL_PRU
	depends on ARCH_DAVINCI && (ARCH_DAVINCI_DA850 || ARCH_DAVINCI_DA830)
	select SERIAL_CORE
	tristate "PRU based SUART emulation for OMAPL"
	---help---
	Enable this to emulate a UART controller on the PRU of OMAPL.
	If not sure, mark N

config OMAPL_SUART_MCASP
    int "McASP number"
    depends on ARCH_DAVINCI && ARCH_DAVINCI_DA830 && SERIAL_SUART_OMAPL_PRU
    default "0"
    ---help---
    Enter the McASP number to use with SUART (0, 1 or 2).
	You will need to recompile the kernel if this is changed.

config OMAPL_SUART_FW_SOURCE
    string "OMAPL SUART source file(s)"
	depends on SERIAL_SUART_OMAPL_PRU
    default ""
    ---help---
	Enter the path for the OMAPL PRU SUART source files (<system path>/pru)
```
